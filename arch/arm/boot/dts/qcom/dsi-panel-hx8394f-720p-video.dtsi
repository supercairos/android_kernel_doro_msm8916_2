/* Copyright (c) 2014, The Linux Foundation. All rights reserved.
 *
 * This program is free software; you can redistribute it and/or modify
 * it under the terms of the GNU General Public License version 2 and
 * only version 2 as published by the Free Software Foundation.
 *
 * This program is distributed in the hope that it will be useful,
 * but WITHOUT ANY WARRANTY; without even the implied warranty of
 * MERCHANTABILITY or FITNESS FOR A PARTICULAR PURPOSE.  See the
 * GNU General Public License for more details.
 */

/*---------------------------------------------------------------------------
 * This file is autogenerated file using gcdb parser. Please do not edit it.
 * Update input XML file to add a new entry or update variable in this file
 * VERSION = "1.0"
 *---------------------------------------------------------------------------*/
&mdss_mdp {
	dsi_hx8394f_720_vid: qcom,mdss_dsi_hx8394f_720p_video {
		qcom,mdss-dsi-panel-name = "hx8394f 720p video mode dsi panel";
		qcom,mdss-dsi-panel-controller = <&mdss_dsi0>;
		qcom,mdss-dsi-panel-type = "dsi_video_mode";
		qcom,mdss-dsi-panel-destination = "display_1";
		qcom,mdss-dsi-panel-framerate = <60>;
		qcom,mdss-dsi-virtual-channel-id = <0>;
		qcom,mdss-dsi-stream = <0>;
		qcom,mdss-dsi-panel-width = <720>;
		qcom,mdss-dsi-panel-height = <1280>;
		qcom,mdss-dsi-h-front-porch = <80>;
		qcom,mdss-dsi-h-back-porch = <92>;
		qcom,mdss-dsi-h-pulse-width = <12>;
		qcom,mdss-dsi-h-sync-skew = <0>;
		qcom,mdss-dsi-v-back-porch = <16>;
		qcom,mdss-dsi-v-front-porch = <10>;
		qcom,mdss-dsi-v-pulse-width = <2>;
		qcom,mdss-dsi-h-left-border = <0>;
		qcom,mdss-dsi-h-right-border = <0>;
		qcom,mdss-dsi-v-top-border = <0>;
		qcom,mdss-dsi-v-bottom-border = <0>;
		qcom,mdss-dsi-bpp = <24>;
		qcom,mdss-dsi-underflow-color = <0xff>;
		qcom,mdss-dsi-border-color = <0>;
		qcom,mdss-dsi-on-command = [
				39 01 00 00 00 00 04
							b9 ff 83 94
				39 01 00 00 00 00 07
							BA 63 03 68 6B B2 C0
				39 01 00 00 00 00 0b
							B1 50 12 72 09 31 54 71 31 50 34
				39 01 00 00 00 00 07
							B2 00 80 64 06 08 2F
				39 01 00 00 00 00 16
							B4 74 76 0D 5C
							5A 5B 01 05 7E
							35 00 3F 01 65
							01 65 01 65 05
							01 7E
				39 01 00 00 00 00 3b
							E0 09 09 15 1B
							1F 23 26 25 4D
							5D 70 71 7B 90
							B4 A4 B4 B5 AF
							B7 C5 61 5E 61
							65 68 6F 7A 7E
							03 09 15 1B 1F
							23 26 25 4D 5D
							70 71 7B 90 7C
							96 A6 A9 A7 B7
							C5 61 5E 61 65
							68 6F 7A 7E
				39 01 00 00 00 00 22
							D3 00 00 06 06
							40 07 0A 0A 32
							10 01 00 01 52
							15 07 05 07 32
							10 00 00 00 67
							44 05 05 37 0E
							0E 27 06 40
				39 01 00 00 00 00 2d
							D5 20 21 00 01
							02 03 04 05 06
							07 18 18 18 18
							18 18 18 18 18
							18 18 18 18 18
							18 18 18 18 18
							18 18 18 18 18
							18 18 18 18 19
							19 18 18 24 25
				39 01 00 00 00 00 2d
							D6 24 25 07 06
							05 04 03 02 01
							00 18 18 18 18
							18 18 18 18 58
							58 18 18 18 18
							18 18 18 18 18
							18 18 18 18 18
							18 18 18 18 18
							18 19 19 20 21
				39 01 00 00 00 00 03
							B6 8F 8F
				39 01 00 00 00 00 02
							CC 0B
				39 01 00 00 00 00 03
							C0 1F 73
				05 01 00 00 78 00 02
							11 00
				05 01 00 00 14 00 02
							29 00];
		qcom,mdss-dsi-off-command = [05 01 00 00 37 00 02 28 00
				05 01 00 00 05 00 02 10 00];
		qcom,mdss-dsi-on-command-state = "dsi_lp_mode";
		qcom,mdss-dsi-off-command-state = "dsi_hs_mode";
		qcom,mdss-dsi-h-sync-pulse = <1>;
		qcom,mdss-dsi-traffic-mode = "burst_mode";
		qcom,mdss-dsi-bllp-eof-power-mode;
		qcom,mdss-dsi-bllp-power-mode;
		qcom,mdss-dsi-lane-0-state;
		qcom,mdss-dsi-lane-1-state;
		qcom,mdss-dsi-lane-2-state;
		qcom,mdss-dsi-lane-3-state;
		qcom,mdss-dsi-panel-timings = [7A 1A 12 00 3E 42 16 1E 14 03 04 00];
		qcom,mdss-dsi-t-clk-post = <0x04>;
		qcom,mdss-dsi-t-clk-pre = <0x18>;
		qcom,mdss-dsi-bl-min-level = <1>;
		qcom,mdss-dsi-bl-max-level = <255>;
		qcom,mdss-dsi-dma-trigger = "trigger_sw";
		qcom,mdss-dsi-mdp-trigger = "none";
		qcom,mdss-dsi-bl-pmic-control-type = "bl_ctrl_pwm";
		qcom,mdss-dsi-bl-pmic-pwm-frequency = <30>;
		qcom,mdss-dsi-bl-pmic-bank-select = <0>;
		qcom,mdss-dsi-pwm-gpio = <&pm8916_mpps 4 0>;
		qcom,mdss-dsi-reset-sequence = <1 1>, <0 1>, <1 50>;
		qcom,mdss-pan-physical-width-dimension = <59>;
		qcom,mdss-pan-physical-height-dimension = <104>;
		qcom,mdss-dsi-lp11-init;
		qcom,cont-splash-enabled;
		qcom,mdss-dsi-panel-orientation = "180";
		//qcom,mdss-dsi-force-clock-lane-hs;
		//qcom,mdss-dsi-init-delay-us = <50000>;
	};
};
